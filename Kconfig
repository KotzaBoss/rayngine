## Kconfig
```kconfig
mainmenu "Project Configuration"


config VERBOSE
	bool "Verbose"


choice BUILD
    prompt "Build type"

    config BUILD_DEBUG
        bool "Debug"
    config BUILD_RELEASE
        bool "Release"
endchoice


menu "Sanitizers"
	choice SANITIZE_MEMORY_CHOICE
		prompt "Sanatize memory"
		optional
		help
			Unfortunately the name of one of the "memory" sanitizers is "Memory sanitizer"...
			Ignoring that, either "Memory" or "Address" sanitizer can be used not both.
			See their "help" for details.

		config SANITIZE_ADDRESS
			bool "Address sanitizer"
			help
				https://github.com/google/sanitizers/wiki/AddressSanitizer

		config SANITIZE_MEMORY
			bool "Memory sanitizer"
			help
				https://github.com/google/sanitizers/wiki/MemorySanitizer
	endchoice


	config SANITIZE_THREAD
		bool "Thread sanatizer"
		help
			https://github.com/google/sanitizers/wiki/ThreadSanitizerCppManual
endmenu


config ODIN_COLLECTION
	string "Where is the -collection:rayngine"
	default "${PROJECT_SOURCE_DIR}/src"


menu "Resources"
	config RESOURCE_DIR
		string "Directory to look for resources"
		default "${CMAKE_BINARY_DIR}/res"

	config MINI_SPACE_PACK_DIR
		string
		default "${RAYNGINE_RESOURCE_DIR}/Mini_space_pack"
endmenu
```
